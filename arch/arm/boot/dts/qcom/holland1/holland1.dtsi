#include "holland1-memory.dtsi"
#include "holland1-qseecom.dtsi"
#include "holland1-power.dtsi"
#include "holland1-pinctrl.dtsi"
#include "holland1-display-regulaters.dtsi"
#include "holland1-display-panel.dtsi"
#include "holland1-notification-led.dtsi"
#include "holland1-audio.dtsi"
#include "holland1-camera.dtsi"
#include "holland1-flash-leds.dtsi"
#include "holland1-fingerprint-sensor.dtsi"
#include "holland1-touch-panel.dtsi"
#include "holland1-misc.dtsi"
