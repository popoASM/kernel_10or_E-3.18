/*
 * Copyright (c) 2015-2016, The Linux Foundation. All rights reserved.
 *
 * Copyright (c) 2020, Shubham-Panwar.
 *
 * This program is free software; you can redistribute it and/or modify
 * it under the terms of the GNU General Public License version 2 and
 * only version 2 as published by the Free Software Foundation.
 *
 * This program is distributed in the hope that it will be useful,
 * but WITHOUT ANY WARRANTY; without even the implied warranty of
 * MERCHANTABILITY or FITNESS FOR A PARTICULAR PURPOSE.  See the
 * GNU General Public License for more details.
 */

/ {
    reserved-memory {
      other_ext_mem: other_ext_region@0 {
			compatible = "removed-dma-pool";
            reg = <0x0 0x84a00000 0x0 0x1E00000>;
		  };
    };
    board_gpios:board_gpios@0 {
		compatible = "pcb-gpio";
		stage-gpio = <12 13 98 99>;
	}; 
};
